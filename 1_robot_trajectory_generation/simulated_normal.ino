#include <AccelStepper.h>
#include <MultiStepper.h>
#include <Wire.h>



// motor pins
// pins for motor driving shoulder rotation
const int dirPin_rot = 2;
const int stepPin_rot = 3;
// pins for motor driving elbow flexion and extension
const int dirPin_ext = 4;
const int stepPin_ext = 5;
// pins for motor driving wrist pronation and supination
const int dirPin_sup = 6;
const int stepPin_sup = 7;

// defining stepper motors
AccelStepper rotMotor(1, stepPin_rot, dirPin_rot);
AccelStepper extMotor(1, stepPin_ext, dirPin_ext);
AccelStepper supMotor(1, stepPin_sup, dirPin_sup);

// SLOW: step modes = {16, 16, 32} , speed /6 , accel*1
// FAST: step modes = {4, 4, 32}   , speed /1 , accel*1

// Considering Step Angle for motors w/ gearbox: 0.094 deg
// for 360 degree is 3829.78723 steps in full step
// to calculate for 90º divide by 4
// rotation and extension motor set to (slow = 1/16th step mode), (fast = 1/4th)
const int rotStepsPerRevolution = (3828/4)*4;
const int extStepsPerRevolution = (3828/4)*4;

// Considering Step Angle for the motor without gearbox: 1.8 deg
// for 360 degree is 200 steps in full step
// to calculate for 180º divide by 2
// supination motor set to (slow = 1/32th step mode), (fast = 1/32th)
const int supStepsPerRevolution = (200/2)*32;

// Set the speed (steps per second) (divide by seconds
const int rotSpeed = rotStepsPerRevolution;
const int extSpeed = extStepsPerRevolution;
const int supSpeed = supStepsPerRevolution;

// Define an array of stepper positions
int supArray[] = {0,9,11,11,11,11,13,14,15,15,15,16,16,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168,180};


void setup() {
  Serial.begin(115200);
  
  // Declare pins as Outputs for motor
  pinMode(stepPin_rot, OUTPUT); 
  pinMode(dirPin_rot, OUTPUT);
  pinMode(stepPin_ext, OUTPUT);
  pinMode(dirPin_ext, OUTPUT);
  pinMode(stepPin_sup, OUTPUT);
  pinMode(dirPin_sup, OUTPUT);

  // Set the initial conditions
  rotMotor.setMaxSpeed(rotSpeed);
  extMotor.setMaxSpeed(extSpeed);
  rotMotor.setAcceleration(rotSpeed);
  extMotor.setAcceleration(extSpeed);
  rotMotor.setCurrentPosition(0);
  extMotor.setCurrentPosition(0);

  //delay(3000);

  Serial.println("Moving rotation to start");
  // Move the motors to the starting position
  rotMotor.moveTo(-rotStepsPerRevolution);
  while(rotMotor.distanceToGo() != 0){
    rotMotor.run();
    }
  Serial.println("Moving extension to start");
  extMotor.moveTo(extStepsPerRevolution);
  while(extMotor.distanceToGo() != 0){
    extMotor.run();
    }
  
  // Reset the initial conditions again!
  supMotor.setMaxSpeed(supSpeed);
  supMotor.setAcceleration(supSpeed);
  supMotor.setCurrentPosition(0);      

  delay(2000);
  
}

int switch_direction_count = 0;
int reps = 0;
int SupElemIntPrev = 0;

void loop() {
  while (reps<15) {
    for(int i = 0; i < 2000; i+=5) {  // for slow i++
      //Serial.println(supArray[i]); // Print the current element to the Serial Monitor
      int SupElemInt = (int)round(supArray[i]*(supStepsPerRevolution/180)); 
      
      if (SupElemInt != SupElemIntPrev) {
        //unsigned long startTime = millis();
        supMotor.runToNewPosition(-SupElemInt);
        //unsigned long elapsedTime = millis() - startTime; 
        //Serial.println(elapsedTime);
      }
      else {
        delay(10);
      }
      SupElemIntPrev = SupElemInt;
      
    } 
    // go to the last value of the array
    supMotor.runToNewPosition(-supStepsPerRevolution);
    
    //Serial.println("Changing Direction");
    int i = 0;
    SupElemIntPrev = supArray[2000];
    for(int i = 0; i < 2000; i+=5) {
      //Serial.println(supArray[2000-i]); // Print the current element to the Serial Monitor
      int SupElemInt = (int)round(supArray[2000-i]*(supStepsPerRevolution/180)); 
      
      if (SupElemInt != SupElemIntPrev) {
        supMotor.runToNewPosition(-SupElemInt);
      }
      else {
        delay(10);
      }
      SupElemIntPrev = SupElemInt;
      
    }
    supMotor.runToNewPosition(0); 
    //Serial.println("Changing Direction Again");
    reps+=1;
    delay(150);
         
  }
  Serial.println("Trajectory finished after n repetitions");
}
